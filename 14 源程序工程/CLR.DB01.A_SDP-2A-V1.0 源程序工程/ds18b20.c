/************************************************************************************
*
* 功能说明：提供使用普通IO端口操作DS18B20的函数。
* 作者信息：品诺电子(http://free-design.taobao.com)
*
************************************************************************************/
#include "stc15w4k32s4.h"
#include "unit.h"
#include "harddrive.h"
#include "uart1.h"
#include "ds18b20.h"
#include "intrins.h"

// 全局变量 保存温度值
volatile	s16 temputer1;  //2  字节
volatile	s16 temputer2;

volatile u8 TemputerHardState1;
volatile u8 TemputerHardState2;

/* 定义DS18B20--第一路 使用的引脚 */
#define DS18B20_1			P25

#define DQ1_1()  		DS18B20_1=1		/* SDA = 1 */
#define DQ1_0()  		DS18B20_1=0		/* SDA = 0 */
	
#define DQ1_READ()  	DS18B20_1	/* 读SDA线状态 */


/* 定义DS18B20--第二路 使用的引脚 */
#define DS18B20_2			P26

#define DQ2_1()  		DS18B20_2=1		/* SDA = 1 */
#define DQ2_0()  		DS18B20_2=0		/* SDA = 0 */
	
#define DQ2_READ()  	DS18B20_2	/* 读SDA线状态 */

/********************************************************************
函数功能：延时函数。
入口参数：无。
返    回：无。
备    注：无。
********************************************************************/
void Ds18Delay3us(void)  //误差 -0.016059027778us
{
    unsigned char a,b;
    for(b=3;b>0;b--)
        for(a=3;a>0;a--);
}
/**///////////////////////Pino Electronics////////////////////////**/

/********************************************************************
函数功能：延时函数。
入口参数：无。
返    回：无。
备    注：无。
********************************************************************/
void Ds18Delay5us(void) //误差 -0.026765046296us
{
    unsigned char a,b;
    for(b=7;b>0;b--)
        for(a=2;a>0;a--);
}
/**///////////////////////Pino Electronics////////////////////////**/

/********************************************************************
函数功能：延时函数。
入口参数：x:循环次数。
返    回：无。
备    注：无。
********************************************************************/
void Delay100us(u32 x)  
{
	u32 j;
	for(j=x;j>0;j--)
	{
	   u8 i;
	  _nop_();
	  i = 69;
	  while (--i);
	}
}


void Ds18Delay10us(u8 x)   //误差 -0.008318865741us
{
  unsigned char a,b;
	for(b=x;b>0;b--)
    for(a=52;a>0;a--);
}
/**///////////////////////Pino Electronics////////////////////////**/

/********************************************第一路函数******************************/
/********************************************************************
函数功能：18b20初始化函数。
入口参数：无。
返    回：u8:返回1表示成功，返回0表示失败。
备    注：无。
********************************************************************/
/*
u8 Ds18_1Reset(void)
{
	u8 ret=0;
	
	DQ1_1();    				//DQ复位
	Ds18Delay3us(); 	//大于1us
	DQ1_0();    				//单片机将DQ拉低
	Ds18Delay10us(48);//精确延时 大于 480us
	DQ1_1();    				//拉高总线
	Ds18Delay10us(6);	//延时大于60us
	ret=DQ1_READ();    //稍做延时后 如果x=0则初始化成功 x=1则初始化失败
	Ds18Delay10us(24);//精确延时 大于 240us
	return !ret;
}
*/
/**///////////////////////Pino Electronics////////////////////////**/



/********************************************************************
函数功能：从DS18B20读一个字节。
入口参数：无。
返    回：读到的字节。
备    注：无。
********************************************************************/
/*
u8 DS18_1_ReadOneChar(void)
{
	u8 i=0;
	u8 dat = 0;
	for (i=8;i>0;i--){
			DQ1_0(); 					//给脉冲信号
  		Ds18Delay3us();	//大于1us
  		dat>>=1;
  		DQ1_1(); 					//给脉冲信号
  		Ds18Delay5us();
  		if(DQ1_READ())
   			dat|=0x80;
  		Ds18Delay10us(5);	//需要延时45us
 	}
 	return(dat);
}
*/
/**///////////////////////Pino Electronics////////////////////////**/

/********************************************************************
函数功能：往DS18B20写入一个字节。
入口参数：dat:待写入的字节。
返    回：无。
备    注：无。
********************************************************************/
/*
void DS18_1_WriteOneChar(u8 dat)
{
	u8 i=0;
 	for (i=8; i>0; i--){
		DQ1_0();
		Ds18Delay3us();	//大于1us
		if(dat&0x01)
			DQ1_1();
		else
			DQ1_0();
		Ds18Delay10us(6);	//需要延时60us
		DQ1_1();
		dat>>=1;
		Ds18Delay3us();	//大于1us
	}
}
*/
/**///////////////////////Pino Electronics////////////////////////**/

/********************************************************************
函数功能：在DS18B20上读取上一次转换的结果，结果写入s16 *pTemp。
入口参数：无。
返    回：u8:返回1表示成功，返回0表示失败。
备    注：注意，不能被打断，调用本函数之前最好关闭中断。
********************************************************************/
/*
u8 DS18_1_ReadTemperature(s16 *pTemp)
{
	u8 lsb,msb;
	u8 ret;
	s16 temp;

	ret=Ds18_1Reset();
	DS18_1_WriteOneChar(0xCC); //跳过读序号列号的操作 
	DS18_1_WriteOneChar(0xBE); //读取温度寄存器等（共可读9个寄存器） 前两个就是温度
	lsb=DS18_1_ReadOneChar();
	msb=DS18_1_ReadOneChar();

	temp=(msb<<8)|lsb;
	temp=temp/16;				//移除小数部分
	*pTemp=temp;
	
	return ret;
}
*/
/**///////////////////////Pino Electronics////////////////////////**/

/********************************************************************
函数功能：在DS18B20上先发起下一次温度转换。
入口参数：无。
返    回：u8:返回1表示成功，返回0表示失败。
备    注：严重注意，不能被打断，调用本函数之前需要关闭中断。
********************************************************************/
/*
u8 DS18_1_StartConv(void)
{
	u8 ret;
	ret=Ds18_1Reset();
	DS18_1_WriteOneChar(0xCC); // 单点总线情况下，跳过读序号列号的操作
	DS18_1_WriteOneChar(0x44); // 启动温度转换，转换需要500ms到1s的时间(典型值750ms)
	return ret;
}
*/
/**///////////////////////Pino Electronics////////////////////////**/

/*************************************END 第一路函数******************************/




/****************************************第二路函数******************************/
/********************************************************************
函数功能：18b20初始化函数。
入口参数：无。
返    回：u8:返回1表示成功，返回0表示失败。
备    注：无。
********************************************************************/
u8 Ds18_2Reset(void)
{
	u8 ret=0;
	
	DQ2_1();    				//DQ复位
	Ds18Delay3us(); 	//大于1us
	DQ2_0();    				//单片机将DQ拉低
	Ds18Delay10us(48);//精确延时 大于 480us
	DQ2_1();    				//拉高总线
	Ds18Delay10us(6);	//延时大于60us
	ret=DQ2_READ();    //稍做延时后 如果x=0则初始化成功 x=1则初始化失败
	Ds18Delay10us(24);//精确延时 大于 240us
	return !ret;
}
/**///////////////////////Pino Electronics////////////////////////**/



/********************************************************************
函数功能：从DS18B20读一个字节。
入口参数：无。
返    回：读到的字节。
备    注：无。
********************************************************************/
u8 DS18_2_ReadOneChar(void)
{
	u8 i=0;
	u8 dat = 0;
	for (i=8;i>0;i--)
	{
			DQ2_0(); 					//给脉冲信号
  		Ds18Delay3us();	//大于1us
  		dat>>=1;
  		DQ2_1(); 					//给脉冲信号
  		Ds18Delay5us();
  		if(DQ2_READ())
   			dat|=0x80;
  		Ds18Delay10us(5);	//需要延时45us
 	}
 	return(dat);
}
/**///////////////////////Pino Electronics////////////////////////**/

/********************************************************************
函数功能：往DS18B20写入一个字节。
入口参数：dat:待写入的字节。
返    回：无。
备    注：无。
********************************************************************/
void DS18_2_WriteOneChar(u8 dat)
{
	u8 i=0;
 	for (i=8; i>0; i--)
	{
		DQ2_0();
		Ds18Delay3us();	//大于1us
		if(dat&0x01)
			DQ2_1();
		else
			DQ2_0();
		Ds18Delay10us(6);	//需要延时60us
		DQ2_1();
		dat>>=1;
		Ds18Delay3us();	//大于1us
	}
}
/**///////////////////////Pino Electronics////////////////////////**/

/********************************************************************
函数功能：在DS18B20上读取上一次转换的结果，结果写入s16 *pTemp。
入口参数：无。
返    回：u8:返回1表示成功，返回0表示失败。
备    注：注意，不能被打断，调用本函数之前最好关闭中断。
********************************************************************/
u8 DS18_2_ReadTemperature(s16 *pTemp)
{
	u8 lsb,msb;
	u8 ret;
	s16 temp;
	ret=Ds18_2Reset();
	DS18_2_WriteOneChar(0xCC); //跳过读序号列号的操作 
	DS18_2_WriteOneChar(0xBE); //读取温度寄存器等（共可读9个寄存器） 前两个就是温度
	lsb=DS18_2_ReadOneChar();
	msb=DS18_2_ReadOneChar();

	temp=(msb<<8)|lsb;
	temp=temp/16;				//移除小数部分
	*pTemp=temp;
	
	return ret;
}
/**///////////////////////Pino Electronics////////////////////////**/

/********************************************************************
函数功能：在DS18B20上先发起下一次温度转换。
入口参数：无。
返    回：u8:返回1表示成功，返回0表示失败。
备    注：严重注意，不能被打断，调用本函数之前需要关闭中断。
********************************************************************/
u8 DS18_2_StartConv(void)
{
	u8 ret;
	ret=Ds18_2Reset();
	DS18_2_WriteOneChar(0xCC); // 单点总线情况下，跳过读序号列号的操作
	DS18_2_WriteOneChar(0x44); // 启动温度转换，转换需要500ms到1s的时间(典型值750ms)
	return ret;
}
/**///////////////////////Pino Electronics////////////////////////**/

/*************************************END 第二路函数******************************/

void HandleDs18b20ReadTemp(void)
{
	//u8 ret1;
	u8 ret2;
	//EA=0;
	//先开始温度测量，测量结果保存在温度传感器寄存器中
	//DS18_1_StartConv();
	DS18_2_StartConv();	
	//EA=1;
	//Delay3us();
	//EA=0;	
	//ret1=DS18_1_ReadTemperature(&temputer1);//读取温度，读取的是上一次测量的结果
	ret2=DS18_2_ReadTemperature(&temputer2);//读取温度，读取的是上一次测量的结果
	//TemputerHardState1=ret1;
	TemputerHardState2=ret2;	
	if(TemputerHardState2==0)
	{
		temputer2=0xFFFF;  //温度传感器异常
  }	
	//EA=1;

}







