/************************************************************************************
* 功能说明：
* 串口驱动程序

************************************************************************************/

#include "stc15w4k32s4.h"
#include "unit.h"
#include "harddrive.h"
#include "uart1.h"


#define	BAUDRATE 	9600UL 		//串口波特率，需要更改波特率时，在此更改数值即可

//以下变量与缓冲区相关



//volatile u8 uart1SendingFlag=0;	 	  //全局变量，串口是否有数据要发送标志

volatile u8 uart1ReceivedFlag=1;		//全局变量，标志串口已接收到数据

volatile u8 uart1ReceiveNum=0;		  //全局变量，标志串口已接收到数据计数

volatile u8 uart1SBuf[UART1_TBUFSIZE];//发送缓冲区，static标识，只在本文件中可以访问

volatile u8 uart1rBuftemp[UART1_RBUFSIZE];//接收缓冲区，static标识，只在本文件中可以访问

volatile u8 uart1rBuf[UART1_RBUFSIZE];//接收缓冲区，static标识，只在本文件中可以访问

/********************************************************************
函数功能：初始化串口1。
入口参数：无。
返    回：无。
备    注：无。
********************************************************************/
void InitUart1(void)
{
	/*初始化定时器1*/	
	
	TMOD&=(~0x30);	//设置Timer1工作在模式0(16位自动重载模式)
	
	AUXR|=0x40;		//设置定时器1为1T模式，默认为12T模式
	
	TH1=(65536-(SYSCLK/4/BAUDRATE))>>8;		//初始化Timer1重载值
	TL1=(65536-(SYSCLK/4/BAUDRATE));		//初始化Timer1重载值
	TR1=1;			//启动定时器
	
	/*初始化串口1*/
	AUXR&=(~0x01);	//设置定时器1作为串口1的波特率发生器，默认设置是定时器2
	SCON=0x50;		//工作方式1，8位可变波特率，允许接收
	PS=1;			//为了在其它中断里输出打印，串口的优先级设为高
	ES=1;			//打开串口中断
	
}
/**///////////////////////Pino Electronics////////////////////////**/

/********************************************************************
函数功能：串口1中断服务程序。
入口参数：无。
返    回：无。
备    注：无。
********************************************************************/
void Uart1ISR(void) interrupt 4 
{
	if(RI)
	{	//检查串口接收标志位
		RI=0;		//清除接收标志位 防止重复进入中断
		
		if(uart1ReceiveNum > 13) //有效命令为13字节
		{//如果当前缓冲区已满
			uart1ReceiveNum=0;	  //防止溢出
		}
		else
		{
			uart1rBuf[uart1ReceiveNum]=SBUF;
			uart1ReceiveNum++;
		}	
		//13字节为有效命令
		if(uart1ReceiveNum ==13 )
		{
			//if((uart1rBuf[0]==0x55)&&(uart1rBuf[uart1ReceiveNum-1]==0x0d) )//判断首尾位以及方向字节是否正确 
      //{				
         uart1ReceivedFlag=1; //置接收标志位
			//}
    }
	}	
}

/********************************************************************
函数功能：串口1发送一个数据
入口参数：要发送数据
返    回：无。
备    注：无。
********************************************************************/
/*
void uart1sendonebyte(u8 x)		          //发送一个数据
{
   SBUF=x;				
   while(!TI);
   TI=0;
}
*/
/********************************************************************
函数功能：串口1发送num 个字节
入口参数：数据地址，数据长度
返    回：无。
备    注：无。
********************************************************************/

void uart1senddata(u8 *p,u8 num)               
{
	u8 i;
	
  for(i=0;i<num;i++)	   
  {
    SBUF=p[i];
    while(!TI);
    TI=0;
  }
}

/**///////////////////////Pino Electronics////////////////////////**/





